## firmware/bus_manager/Kconfig
```kconfig
orsource "$IDF_PATH/examples/common_components/env_caps/$IDF_TARGET/Kconfig.env_caps"

menu "MCM - Bus Configuration"

    config BUS_VOLTAGE_5V_CTRL
        int "5V Vbus control pin number"
        range ENV_GPIO_RANGE_MIN ENV_GPIO_IN_RANGE_MAX
        default 9
        help
            GPIO number for the 5V Vbus control pin.

    config BUS_VOLTAGE_VOUT_CTRL
        int "Vout Vbus control pin number"
        range ENV_GPIO_RANGE_MIN ENV_GPIO_IN_RANGE_MAX
        default 10
        help
            GPIO number for the Vout Vbus control pin.

endmenu
```

## firmware/device_status/Kconfig
```kconfig
orsource "$IDF_PATH/examples/common_components/env_caps/$IDF_TARGET/Kconfig.env_caps"

menu "MCM - Device Status Configuration"

    config LED_HEARTBEAT
        int "Heartbeat LED pin number"
        range ENV_GPIO_RANGE_MIN ENV_GPIO_IN_RANGE_MAX
        default 11
        help
            GPIO number for heartbeat LED pin.

    config LED_STATUS
        int "STATUS LED pin number"
        range ENV_GPIO_RANGE_MIN ENV_GPIO_IN_RANGE_MAX
        default 12
        help
            GPIO number for STATUS LED pin.

endmenu
```

## firmware/lin_master/Kconfig
```kconfig
orsource "$IDF_PATH/examples/common_components/env_caps/$IDF_TARGET/Kconfig.env_caps"

menu "LIN Master Configuration"

    config LIN_MASTER_UART_PORT_NUM
        int "LIN master UART port number"
        range 0 2 if IDF_TARGET_ESP32 || IDF_TARGET_ESP32S3
        default 2 if IDF_TARGET_ESP32 || IDF_TARGET_ESP32S3
        range 0 1
        default 1
        help
            UART communication port number for the LIN master.
            See UART documentation for available port numbers.

    config LIN_MASTER_RXD
        int "LIN transceiver RXD pin number"
        range ENV_GPIO_RANGE_MIN ENV_GPIO_IN_RANGE_MAX
        default 6
        help
            GPIO number for LIN master RX pin. See UART documentation for more information
            about available pin numbers for UART.

    config LIN_MASTER_TXD
        int "LIN transceiver TXD pin number"
        range ENV_GPIO_RANGE_MIN ENV_GPIO_OUT_RANGE_MAX
        default 7
        help
            GPIO number for LIN master TX pin. See UART documentation for more information
            about available pin numbers for UART.

    config LIN_MASTER_SLEEP
        int "LIN transceiver sleep pin number"
        range ENV_GPIO_RANGE_MIN ENV_GPIO_IN_RANGE_MAX
        default 15
        help
            GPIO number for LIN master sleep pin.

endmenu
```

## firmware/power_ctrl/Kconfig
```kconfig
orsource "$IDF_PATH/examples/common_components/env_caps/$IDF_TARGET/Kconfig.env_caps"

menu "MCM - Slave Power Configuration"

    config SLAVE_POWER_CTRL
        int "Slave power control pin number"
        range ENV_GPIO_RANGE_MIN ENV_GPIO_IN_RANGE_MAX
        default 5
        help
            GPIO number for slave power control pin.

    config SLAVE_POWER_SENSE
        int "Slave power current sensor pin number"
        range ENV_GPIO_RANGE_MIN ENV_GPIO_IN_RANGE_MAX
        default 4
        help
            GPIO number for slave power current sensor pin.

endmenu
```

## firmware/sdkconfig.defaults
```kconfig
#
# LWIP
#
CONFIG_LWIP_LOCAL_HOSTNAME="mcm-lin"

#
# DHCP server
#
CONFIG_LWIP_DHCPS=n

#
# ESP HTTPS server
#
CONFIG_ESP_HTTPS_SERVER_ENABLE=y

#
# HTTP Server
#
CONFIG_HTTPD_WS_SUPPORT=y

CONFIG_HTTPD_MAX_REQ_HDR_LEN=1024
CONFIG_SPIFFS_OBJ_NAME_LEN=64
CONFIG_FATFS_LFN_HEAP=y
CONFIG_ESPTOOLPY_FLASHSIZE_16MB=y
CONFIG_PARTITION_TABLE_CUSTOM=y
CONFIG_PARTITION_TABLE_CUSTOM_FILENAME="partitions.csv"
CONFIG_PARTITION_TABLE_FILENAME="partitions.csv"
CONFIG_LWIP_MAX_SOCKETS=16

#
# ESP PSRAM
#
CONFIG_SPIRAM=y

#
# SPI RAM config
#
CONFIG_SPIRAM_MODE_OCT=y

#
# Ethernet
#
CONFIG_ETH_ENABLED=n

#
# mbedTLS
#
CONFIG_MBEDTLS_DEFAULT_MEM_ALLOC=y
CONFIG_MBEDTLS_TLS_SERVER_ONLY=y
CONFIG_MBEDTLS_SSL_PROTO_TLS1_2=y
CONFIG_MBEDTLS_SSL_PROTO_TLS1_3=n

#
# FreeRTOS
#
CONFIG_FREERTOS_HZ=200
CONFIG_FREERTOS_WATCHPOINT_END_OF_STACK=y

#
# Ultra Low Power (ULP) Co-processor
#
# CONFIG_ULP_COPROC_ENABLED=y

#
# USB-OTG
#
CONFIG_USB_OTG_SUPPORTED=n

#
# TinyUSB Stack
#
CONFIG_TINYUSB_DEBUG_LEVEL=0
CONFIG_TINYUSB_VENDOR_COUNT=1

#
# Communication Device Class (CDC)
#
CONFIG_TINYUSB_CDC_ENABLED=n

#
# Human Interface Device Class (HID)
#
CONFIG_TINYUSB_HID_COUNT=0

#
# Bootloader config
#
CONFIG_BOOTLOADER_APP_ROLLBACK_ENABLE=y

#
# MCM - PPM Bootloader Configuration
#
CONFIG_PPM_BOOTLOADER_RX=47
CONFIG_PPM_BOOTLOADER_TX=48
CONFIG_PPM_BOOTLOADER_TX_INVERT=n
# CONFIG_RMT_ISR_IRAM_SAFE=n
# CONFIG_RMT_RECV_FUNC_IN_IRAM=n
# CONFIG_RMT_ENABLE_DEBUG_LOG=n
```
